## meta/meta-orion/conf/layer.conf
```bitbake
BBPATH .= ":${LAYERDIR}"

BBFILES += " \
    ${LAYERDIR}/recipes-*/*/*.bb \
    ${LAYERDIR}/recipes-*/*/*.bbappend \
"

BBFILE_COLLECTIONS += "meta-orion"
BBFILE_PATTERN_meta-orion = "^${LAYERDIR}/"
BBFILE_PRIORITY_meta-orion = "10"

LAYERDEPENDS_meta-orion = "core xilinx kria"
LAYERSERIES_COMPAT_meta-orion = "scarthgap"
```
